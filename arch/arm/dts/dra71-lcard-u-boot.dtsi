/*
 * Copyright (C) 2018 Texas Instruments Incorporated - http://www.ti.com/
 *
 * SPDX-License-Identifier:	GPL-2.0+
 */

#include "omap5-u-boot.dtsi"

&usb1 {
	status = "disabled";
};

&omap_dwc3_1 {
	status = "disabled";
};

&mmc2 {
	/delete-property/ vmmc-supply;
};
