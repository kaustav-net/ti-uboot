/*
 * Copyright (C) 2018 Texas Instruments Incorporated - http://www.ti.com/
 *
 * SPDX-License-Identifier:	GPL-2.0+
 */

#include "omap5-u-boot.dtsi"

&pcf_gpio_21{
	u-boot,i2c-offset-len = <0>;
};

&pcf_hdmi{
	u-boot,i2c-offset-len = <0>;
};

&usb1 {
	status = "disabled";
};

&omap_dwc3_1 {
	status = "disabled";
};
